#include <Wire.h>
#include <U8g2lib.h>
#include <avr/wdt.h>

// HAP - ovladač výhřevu sedaček pro Arduino Nano
// Verze: V1.2
const char VERZE_PROGRAMU[] = "V1.2";

// Displej SH1106 128x64 přes hardwarové I2C.
// Na Arduino Nano jsou I2C piny pevně dané: SDA = A4, SCL = A5.
U8G2_SH1106_128X64_NONAME_F_HW_I2C u8g2(U8G2_R0, U8X8_PIN_NONE);

// Rozměry displeje
#define SIRKA_DISPLEJE 128
#define VYSKA_DISPLEJE 64

// Definice pinů
#define VSTUP_LEVA_NIZKY      2
#define VSTUP_LEVA_VYSOKY     3
#define VSTUP_PRAVA_NIZKY     4
#define VSTUP_PRAVA_VYSOKY    5
#define PIN_POMOCNY_VYSTUP    6
#define RELE_LEVA_NIZKY       7
#define RELE_LEVA_VYSOKY      8
#define RELE_PRAVA_NIZKY      9
#define RELE_PRAVA_VYSOKY     10
#define PIN_MERENI_NAPETI     A0 

// Bitmapy
const unsigned char startovaciLogo[] PROGMEM = {
	0x00, 0x00, 0x00, 0x00, 0x00, 0x00, 0x00, 0x00, 0x00, 0x00, 0x00, 0x00, 0x00, 0x00, 0x00, 0x00, 
	0x00, 0x00, 0x00, 0x00, 0x00, 0x00, 0x00, 0x00, 0x00, 0x00, 0x00, 0x00, 0x00, 0x00, 0x00, 0x00, 
	0x00, 0x00, 0x00, 0x00, 0x00, 0x00, 0x00, 0x00, 0x00, 0x00, 0x00, 0x00, 0x00, 0x00, 0x00, 0x00, 
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	0x00, 0x00, 0x00, 0x00, 0x00, 0x00, 0x00, 0x00, 0x00, 0x00, 0x00, 0x00, 0x00, 0x00, 0x00, 0x00
	};
const unsigned char logoNecinnosti[] PROGMEM = {
  0x00, 0x00, 0x00, 0x00, 0x00, 0x00, 0x00, 0x00, 0x00, 0x00, 0x00, 0x00, 0x00, 0x00, 0x00, 0x00, 
	0x00, 0x00, 0x00, 0x00, 0x00, 0x00, 0x00, 0x00, 0x00, 0x00, 0x00, 0x00, 0x00, 0x00, 0x00, 0x00, 
	0x00, 0x00, 0x00, 0x00, 0x00, 0x00, 0x00, 0x00, 0x00, 0x00, 0x00, 0x00, 0x00, 0x00, 0x00, 0x00, 
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	0x00, 0x00, 0x00, 0x00, 0x00, 0x00, 0x00, 0x00, 0x00, 0x00, 0x00, 0x00, 0x00, 0x00, 0x00, 0x00
};

// Globální proměnné pro bitmapy
const unsigned char *vybraneLogo;          // Logo při startovací animaci
const unsigned char *logoNecinnostiPtr;    // Logo pro animaci při nečinnosti

// Stav výhřevu jedné sedačky
enum StavVyhrevu { VYPNUTO, NIZKY_STUPEN, VYSOKY_STUPEN };
StavVyhrevu stavLeveSedacky = VYPNUTO;
StavVyhrevu stavPraveSedacky = VYPNUTO;

// Stav napájecí soustavy
enum StavNapeti { NAPETI_OK, NAPETI_NIZKE, NAPETI_VYSOKE };
StavNapeti stavNapeti = NAPETI_OK;

const unsigned long ZPOZDENI_ZAKMITU = 50;
unsigned long posledniCasZakmitu = 0;
unsigned long posledniAktualizaceDispleje = 0;
unsigned long posledniMereniNapeti = 0;
const unsigned long INTERVAL_AKTUALIZACE_DISPLEJE = 100;
const unsigned long INTERVAL_MERENI_NAPETI = 1000;
float posledniNapeti = -1.0;
char textNapeti[10] = "0.0V";

// Teplotní ochranu řeší samotné vyhřívací deky svým odpojovacím čidlem.
// Arduino zde hlídá hlavně napájení, ovládání a zobrazení stavu.
// Hodnoty jsou na jednom místě kvůli ladění v autě.
const float PRAH_PODPETI_VYPNUTI = 11.8; // Pod touto hodnotou se výhřev vypne
const float PRAH_PODPETI_NAVRAT = 12.4;  // Znovu se povolí až po návratu nad tuto hodnotu
const float PRAH_PREPETI_VYPNUTI = 15.5; // Ochrana při vadném dobíjení nebo špičce
const float PRAH_PREPETI_NAVRAT = 15.0;  // Hystereze pro návrat z přepětí

// Proměnné pro animaci a časovač nečinnosti
const unsigned long CAS_DO_ANIMACE_NECINNOSTI = 300000; // 5 minut v milisekundách
unsigned long posledniAktivita = 0;                      // Čas poslední změny stavu
bool rezimAnimace = false;                               // Aktivní režim animace
int poziceAnimaceX = SIRKA_DISPLEJE;                     // Počáteční pozice vpravo
const int RYCHLOST_ANIMACE = 20;      

// Chyba přepínače nastane, když jsou u jedné sedačky současně sepnuté LOW i HIGH.
bool chybaVstupu = false;

void setup() {
  wdt_disable();
  wdt_enable(WDTO_2S);

  // Aktivně-low relé držíme vypnutá ještě před přepnutím pinů na výstup.
  digitalWrite(RELE_LEVA_NIZKY, HIGH);
  digitalWrite(RELE_LEVA_VYSOKY, HIGH);
  digitalWrite(RELE_PRAVA_NIZKY, HIGH);
  digitalWrite(RELE_PRAVA_VYSOKY, HIGH);
  digitalWrite(PIN_POMOCNY_VYSTUP, LOW);

  pinMode(VSTUP_LEVA_NIZKY, INPUT_PULLUP);
  pinMode(VSTUP_LEVA_VYSOKY, INPUT_PULLUP);
  pinMode(VSTUP_PRAVA_NIZKY, INPUT_PULLUP);
  pinMode(VSTUP_PRAVA_VYSOKY, INPUT_PULLUP);
  
  pinMode(PIN_POMOCNY_VYSTUP, OUTPUT);

  pinMode(RELE_LEVA_NIZKY, OUTPUT);
  pinMode(RELE_LEVA_VYSOKY, OUTPUT);
  pinMode(RELE_PRAVA_NIZKY, OUTPUT);
  pinMode(RELE_PRAVA_VYSOKY, OUTPUT);

  pinMode(PIN_MERENI_NAPETI, INPUT);

  // Inicializace displeje
  u8g2.begin();
  u8g2.clearDisplay();

  // Nastavení log
  vybraneLogo = startovaciLogo;          // Startovací animace
  logoNecinnostiPtr = logoNecinnosti;    // Animace při nečinnosti

  // První měření napětí uděláme hned, aby ochrana fungovala už od startu.
  aktualizujMereniNapeti(true);
  posledniAktivita = millis();

  // Načítací animace
  for (int x = 0; x <= 125; x += 4) {
    u8g2.firstPage();
    do {
      u8g2.drawXBMP(0, -10, 126, VYSKA_DISPLEJE, vybraneLogo);
      u8g2.drawBox(0, VYSKA_DISPLEJE - 8, x, 4);
    } while (u8g2.nextPage());
    wdt_reset();
  }

  aktualizujDisplej();
}

void loop() {
  bool zmenaStavu = zpracujPrepinace();
  bool zmenaNapeti = aktualizujMereniNapeti(false);
  nastavVystupy();

  unsigned long aktualniCas = millis();
  if (zmenaStavu || zmenaNapeti || (aktualniCas - posledniAktualizaceDispleje >= INTERVAL_AKTUALIZACE_DISPLEJE)) {
    aktualizujDisplej();
    posledniAktualizaceDispleje = aktualniCas;
  }
  wdt_reset();
}

bool zpracujPrepinace() {
  bool zmenaStavu = false;
  unsigned long aktualniCas = millis();

  if (aktualniCas - posledniCasZakmitu > ZPOZDENI_ZAKMITU) {
    bool levaNizkySepnuty = digitalRead(VSTUP_LEVA_NIZKY) == LOW;
    bool levaVysokySepnuty = digitalRead(VSTUP_LEVA_VYSOKY) == LOW;
    bool pravaNizkySepnuty = digitalRead(VSTUP_PRAVA_NIZKY) == LOW;
    bool pravaVysokySepnuty = digitalRead(VSTUP_PRAVA_VYSOKY) == LOW;

    StavVyhrevu novyStavLeve = VYPNUTO;
    StavVyhrevu novyStavPrave = VYPNUTO;
    bool novaChybaVstupu = (levaNizkySepnuty && levaVysokySepnuty) || (pravaNizkySepnuty && pravaVysokySepnuty);

    if (levaNizkySepnuty && !levaVysokySepnuty) {
      novyStavLeve = NIZKY_STUPEN;
    } else if (levaVysokySepnuty && !levaNizkySepnuty) {
      novyStavLeve = VYSOKY_STUPEN;
    }

    if (pravaNizkySepnuty && !pravaVysokySepnuty) {
      novyStavPrave = NIZKY_STUPEN;
    } else if (pravaVysokySepnuty && !pravaNizkySepnuty) {
      novyStavPrave = VYSOKY_STUPEN;
    }

    posledniCasZakmitu = aktualniCas;

    if (novyStavLeve != stavLeveSedacky || novyStavPrave != stavPraveSedacky || novaChybaVstupu != chybaVstupu) {
      stavLeveSedacky = novyStavLeve;
      stavPraveSedacky = novyStavPrave;
      chybaVstupu = novaChybaVstupu;
      zmenaStavu = true;
      // Reset časovače nečinnosti a animace
      posledniAktivita = aktualniCas;
      rezimAnimace = false;
      poziceAnimaceX = SIRKA_DISPLEJE; // Reset na pravou stranu
    }
  }

  return zmenaStavu;
}

void nastavVystupy() {
  bool vyhrevPovolen = (stavNapeti == NAPETI_OK) && !chybaVstupu;

  // Relé jsou aktivně-low: LOW = sepnuto, HIGH = vypnuto.
  digitalWrite(RELE_LEVA_NIZKY, vyhrevPovolen && stavLeveSedacky == NIZKY_STUPEN ? LOW : HIGH);
  digitalWrite(RELE_LEVA_VYSOKY, vyhrevPovolen && stavLeveSedacky == VYSOKY_STUPEN ? LOW : HIGH);
  digitalWrite(RELE_PRAVA_NIZKY, vyhrevPovolen && stavPraveSedacky == NIZKY_STUPEN ? LOW : HIGH);
  digitalWrite(RELE_PRAVA_VYSOKY, vyhrevPovolen && stavPraveSedacky == VYSOKY_STUPEN ? LOW : HIGH);

  // Pomocný výstup je aktivní jen při povoleném režimu HIGH.
  digitalWrite(PIN_POMOCNY_VYSTUP, vyhrevPovolen && (stavLeveSedacky == VYSOKY_STUPEN || stavPraveSedacky == VYSOKY_STUPEN) ? HIGH : LOW);
}

// Funkce pro průměrování napětí
float prectiPrumerneNapeti() {
  const int pocetMereni = 10;
  long soucet = 0;
  for (int i = 0; i < pocetMereni; i++) {
    soucet += analogRead(PIN_MERENI_NAPETI);
    delay(1);
  }
  float prumer = soucet / (float)pocetMereni;
  const float KALIBRACE_NAPETI = 4.67; // Uprav podle měření (14.0 V / 8.5 V * 3.0)
  return prumer * (5.0 / 1023.0) * KALIBRACE_NAPETI;
}

void aktualizujStavNapeti(float napeti) {
  if (stavNapeti == NAPETI_NIZKE && napeti >= PRAH_PODPETI_NAVRAT) {
    stavNapeti = NAPETI_OK;
  } else if (stavNapeti == NAPETI_VYSOKE && napeti <= PRAH_PREPETI_NAVRAT) {
    stavNapeti = NAPETI_OK;
  }

  if (stavNapeti == NAPETI_OK) {
    if (napeti < PRAH_PODPETI_VYPNUTI) {
      stavNapeti = NAPETI_NIZKE;
    } else if (napeti > PRAH_PREPETI_VYPNUTI) {
      stavNapeti = NAPETI_VYSOKE;
    }
  }
}

bool aktualizujMereniNapeti(bool vynutitMereni) {
  unsigned long aktualniCas = millis();
  if (!vynutitMereni && aktualniCas - posledniMereniNapeti < INTERVAL_MERENI_NAPETI) {
    return false;
  }

  float napeti = prectiPrumerneNapeti();
  float predchoziNapeti = posledniNapeti;
  StavNapeti predchoziStav = stavNapeti;

  aktualizujStavNapeti(napeti);
  posledniNapeti = napeti;
  posledniMereniNapeti = aktualniCas;

  bool zmenaZobrazeni = predchoziNapeti < 0 || abs(napeti - predchoziNapeti) > 0.2 || predchoziStav != stavNapeti;
  if (zmenaZobrazeni) {
    dtostrf(napeti, 4, 1, textNapeti);
    size_t delka = strlen(textNapeti);
    if (delka < sizeof(textNapeti) - 1) {
      textNapeti[delka] = 'V';
      textNapeti[delka + 1] = '\0';
    }
  }

  return zmenaZobrazeni;
}

void vykresliSpodniStav() {
  if (chybaVstupu) {
    u8g2.setFont(u8g2_font_6x13B_tr);
    u8g2.drawStr(18, 55, "CHYBA SPINACE");
    return;
  }

  if (stavNapeti == NAPETI_NIZKE) {
    u8g2.setFont(u8g2_font_6x13B_tr);
    u8g2.drawStr(20, 55, "NIZKE NAPETI");
    return;
  }

  if (stavNapeti == NAPETI_VYSOKE) {
    u8g2.setFont(u8g2_font_6x13B_tr);
    u8g2.drawStr(16, 55, "VYSOKE NAPETI");
    return;
  }

  u8g2.setFont(u8g2_font_courB24_tr);
  u8g2.drawStr(15, 60, textNapeti);
}

void aktualizujDisplej() {
  unsigned long aktualniCas = millis();
  bool obeSedackyVypnute = stavLeveSedacky == VYPNUTO && stavPraveSedacky == VYPNUTO;
  bool muzePouzitAnimaci = obeSedackyVypnute && !chybaVstupu && stavNapeti == NAPETI_OK;

  if (muzePouzitAnimaci && aktualniCas - posledniAktivita >= CAS_DO_ANIMACE_NECINNOSTI) {
    rezimAnimace = true;
  } else if (!muzePouzitAnimaci) {
    rezimAnimace = false;
    poziceAnimaceX = SIRKA_DISPLEJE;
  }

  u8g2.firstPage();
  do {
    // Horizontální čára je společná pro běžný režim i animaci.
    u8g2.drawBox(0, VYSKA_DISPLEJE / 2 - 1, SIRKA_DISPLEJE, 3);

    if (rezimAnimace) {
      // Animace při nečinnosti běží pouze tehdy, když jsou obě sedačky vypnuté.
      int nahodneY = random(0, 2);
      u8g2.drawXBMP(poziceAnimaceX, nahodneY, 126, 30, logoNecinnostiPtr);

      if (aktualniCas - posledniAktualizaceDispleje >= RYCHLOST_ANIMACE) {
        int nahodnyPosun = random(3, 10);
        poziceAnimaceX -= nahodnyPosun;
        if (poziceAnimaceX < -126) {
          poziceAnimaceX = SIRKA_DISPLEJE;
        }
      }
    } else {
      // Běžný režim: horní část ukazuje levou a pravou sedačku.
      u8g2.drawBox(SIRKA_DISPLEJE / 2 - 1, 0, 3, VYSKA_DISPLEJE / 2);
      u8g2.setFont(u8g2_font_ncenB14_tr);

      const char* levyText;
      int levyX;
      switch (stavLeveSedacky) {
        case VYSOKY_STUPEN:
          levyText = "HIGH";
          levyX = 6;
          break;
        case NIZKY_STUPEN:
          levyText = "LOW";
          levyX = 10;
          break;
        default:
          levyText = "OFF";
          levyX = 14;
          break;
      }
      u8g2.drawStr(levyX, 27, levyText);

      const char* pravyText;
      int pravyX;
      switch (stavPraveSedacky) {
        case VYSOKY_STUPEN:
          pravyText = "HIGH";
          pravyX = 68;
          break;
        case NIZKY_STUPEN:
          pravyText = "LOW";
          pravyX = 75;
          break;
        default:
          pravyText = "OFF";
          pravyX = 78;
          break;
      }
      u8g2.drawStr(pravyX, 27, pravyText);
    }

    vykresliSpodniStav();
  } while (u8g2.nextPage());
}
